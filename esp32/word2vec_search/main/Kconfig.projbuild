## esp32/word2vec_search/main/Kconfig.projbuild
```kconfig
menu "Word2Vec Search Configuration"

    config WORD2VEC_WIFI_SSID
        string "Wi-Fi SSID"
        default "myssid"
        help
            SSID of the Wi-Fi network to connect to.

    config WORD2VEC_WIFI_PASSWORD
        string "Wi-Fi Password"
        default "mypassword"
        help
            Password for the Wi-Fi network.

    config WORD2VEC_LOG_SD_CONTENTS
        bool "Log full SD card contents after database open"
        default y
        help
            Enable verbose SD card directory logging after a successful boot.
            This is useful when verifying which database directories and files
            are visible on the mounted SD card.

endmenu
```
